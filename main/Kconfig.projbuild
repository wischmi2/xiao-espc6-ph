## main/Kconfig.projbuild
```kconfig
menu "pH Monitor Configuration"

config PH_POLL_INTERVAL_S
    int "Wake / poll interval (seconds)"
    default 60
    range 10 3600
    help
        Deep sleep duration between pH readings.

config PH_BOOT_GRACE_S
    int "Boot grace period (seconds)"
    default 10
    range 0 120
    help
        After wake, keep the serial shell open this long before starting
        the measurement cycle (time to connect and type settings).

config PH_SENSOR_I2C_PORT
    int "I2C port number"
    default 0
    range 0 1

config PH_SENSOR_I2C_SDA_GPIO
    int "I2C SDA GPIO (D4 = GPIO22)"
    default 22
    range 0 30

config PH_SENSOR_I2C_SCL_GPIO
    int "I2C SCL GPIO (D5 = GPIO23)"
    default 23
    range 0 30

config PH_SENSOR_I2C_ADDR
    hex "EZO pH I2C address (default 0x63 = decimal 99)"
    default 0x63
    range 0x08 0x77

config PH_SENSOR_I2C_FREQ_HZ
    int "I2C clock frequency (Hz)"
    default 100000
    range 10000 400000

config PH_EZO_UART_TX_GPIO
    int "EZO UART TX GPIO for mode switch (D6 = GPIO16)"
    default 16
    range 0 30
    help
        XIAO D6 connects to EZO RX for one-time UART mode switch.

config PH_EZO_UART_RX_GPIO
    int "EZO UART RX GPIO for mode switch (D7 = GPIO17)"
    default 17
    range 0 30
    help
        XIAO D7 connects to EZO TX for one-time UART mode switch.

config TEMP_SENSOR_GPIO
    int "DS18B20 data GPIO (D2 = GPIO2)"
    default 2
    range 0 30

config PH_BATTERY_ADC_GPIO
    int "Battery sense GPIO (A0/D0 = GPIO0)"
    default 0
    range 0 30

config PH_BATTERY_LOW_V
    int "Low battery cutoff (millivolts)"
    default 3000
    range 2500 3500
    help
        Skip WiFi and streaming below this voltage.

config PH_STREAM_ACK_TIMEOUT_MS
    int "Stream ACK timeout (ms)"
    default 10000
    range 1000 60000

endmenu
```

## sdkconfig.defaults
```kconfig
CONFIG_IDF_TARGET="esp32c6"

# XIAO ESP32-C6 has no USB-UART bridge; console I/O must use USB Serial/JTAG.
CONFIG_ESP_CONSOLE_USB_SERIAL_JTAG=y
CONFIG_ESP_CONSOLE_SECONDARY_NONE=y

CONFIG_MBEDTLS_SSL_PROTO_DTLS=y
CONFIG_MBEDTLS_PSK_MODES=y
CONFIG_MBEDTLS_KEY_EXCHANGE_PSK=y
CONFIG_MBEDTLS_TLS_CLIENT_ONLY=y
CONFIG_LWIP_NETBUF_RECVINFO=y
CONFIG_FREERTOS_USE_TRACE_FACILITY=y
CONFIG_FREERTOS_USE_STATS_FORMATTING_FUNCTIONS=y
CONFIG_ESP_WIFI_SOFTAP_SUPPORT=n

CONFIG_COMPILER_OPTIMIZATION_SIZE=y

CONFIG_GOLIOTH_AUTO_LOG_TO_CLOUD=y
CONFIG_GOLIOTH_COAP_REQUEST_QUEUE_MAX_ITEMS=20
CONFIG_GOLIOTH_STREAM=y
```
